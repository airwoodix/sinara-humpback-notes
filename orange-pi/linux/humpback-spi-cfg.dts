/dts-v1/;
/plugin/;

/ {
	compatible = "allwinner,sun8i-h3";

	fragment@0 {
		target-path = "/aliases";
		__overlay__ {
			spi2 = &cfg_spi;
		};
	};

	fragment@1 {
		target-path = "/";
		__overlay__ {
			cfg_spi: spi2 {
				compatible = "spi-gpio";
				#address-cells = <0x1>;
				ranges;
				status = "okay";

				sck-gpios = <&pio 0 7 0>; /* PA07 */
				miso-gpios = <&pio 0 6 0>; /* PA06 */
				mosi-gpios = <&pio 0 18 0>; /* PA18 */
				cs-gpios = <&pio 0 10 1>; /* PA10, active low */
				num-chipselects = <1>;
			};
		};
	};

	fragment@2 {
		target = <&cfg_spi>;
		__overlay__ {
			spidev_cfg {
				compatible = "spidev";
				reg = <0>;
				#address-cells = <0x1>;
				#size-cells = <0x0>;
				spi-max-frequency = <100000000>;
				status = "okay";
			};
		};
	};
};
